&uart1 {
	status = "okay";

	current-speed = <115200>;
	tx-pin = <0>;
	rx-pin = <2>;
};

&uart2 {
	compatible = "nordic,nrf-uarte";
	//current-speed = <921600>;
	current-speed = <115200>;
	// for CTS  RTS support
	/*
	tx-pin = <4>;
	rx-pin = <2>;
	rts-pin = <3>;
	cts-pin = <0>;
	hw-flow-control;
	*/

	// without CTS RTS support
	tx-pin = <3>; // Feather nRF9160 D7 (as marked on the silkscreen)
	rx-pin = <1>; // Feather nRF9160 D5 (as marked on the silkscreen)
};
