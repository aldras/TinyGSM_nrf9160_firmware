## v1.4.99-dev1/nrf/applications/serial_lte_modem_actinius_icarus_921600/build/mcuboot/Kconfig/Kconfig.modules
```kconfig
osource "/opt/nordic/ncs/v1.4.99-dev1/nrf/Kconfig.nrf"

osource "/opt/nordic/ncs/v1.4.99-dev1/bootloader/mcuboot/zephyr/Kconfig"

osource "/opt/nordic/ncs/v1.4.99-dev1/nrfxlib/Kconfig.nrfxlib"
```

## v1.4.99-dev1/nrf/applications/serial_lte_modem_nrf9160dk_115200/build/spm/Kconfig/Kconfig.shield.defconfig
```kconfig
osource "/opt/nordic/ncs/v1.4.99-dev1/nrf/boards/shields/*/Kconfig.defconfig"
osource "/opt/nordic/ncs/v1.4.99-dev1/zephyr/boards/shields/*/Kconfig.defconfig"
```
