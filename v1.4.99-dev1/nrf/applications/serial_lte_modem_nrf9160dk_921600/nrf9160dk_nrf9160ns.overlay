&uart1 {
	status = "okay";

	current-speed = <115200>;
	tx-pin = <0>;
	rx-pin = <2>;
};

&uart2 {
	compatible = "nordic,nrf-uarte";
	current-speed = <921600>;
	//current-speed = <115200>;
	// for CTS  RTS support
	/*
	tx-pin = <10>;
	rx-pin = <11>;
	rts-pin = <12>;
	cts-pin = <13>;
	hw-flow-control;
	*/

	// without CTS RTS support
	tx-pin = <10>;
	rx-pin = <11>;
};
